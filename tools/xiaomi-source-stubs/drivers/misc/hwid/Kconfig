## tools/xiaomi-source-stubs/drivers/misc/hwid/Kconfig
```kconfig
# Xiaomi's public Onyx source references this proprietary module but omits it.
config MI_HARDWARE_ID
	tristate "Xiaomi hardware ID support"
	default n
```

## tools/xiaomi-source-stubs/drivers/power/supply/mca/Kconfig
```kconfig
# Xiaomi publishes this path as a symlink into an unavailable proprietary tree.
menu "Xiaomi MCA source-release placeholders"

config MCA_PROTOCOL_PD
	tristate "MCA PD protocol"
	default n

config MCA_PROTOCOL_QC
	tristate "MCA QC protocol"
	default n

config MCA_EXTERNAL_FG
	tristate "MCA external fuel gauge"
	default n

config MCA_EXTERNAL_CP
	tristate "MCA external charge pump"
	default n

config MCA_EXTERNAL_WIRELESS
	tristate "MCA external wireless charging"
	default n

config MCA_QCOM_SUBPMIC
	tristate "MCA Qualcomm sub-PMIC"
	default n

config MCA_QCOM_ADSP
	tristate "MCA Qualcomm ADSP"
	default n

config MCA_QCOM_SYSFS
	tristate "MCA Qualcomm sysfs"
	default n

config MCA_QCOM_SMEM
	tristate "MCA Qualcomm SMEM"
	default n

config MCA_QCOM_PANEL
	tristate "MCA Qualcomm panel integration"
	default n

config MCA_EXTERNAL_BOOST
	tristate "MCA external boost"
	default n

config MCA_EXTERNAL_LOADSWITCH
	tristate "MCA external load switch"
	default n

config MCA_EXTERNAL_CP_SC8541
	tristate "MCA SC8541 charge pump"
	default n

config MCA_EXTERNAL_WIRELESS_SC96281
	tristate "MCA SC96281 wireless charging"
	default n

config MCA_UT_TEST
	tristate "MCA unit tests"
	default n

endmenu
```
