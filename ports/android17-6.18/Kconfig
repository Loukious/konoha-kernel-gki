## ports/android17-6.18/Kconfig
```kconfig
# SPDX-License-Identifier: GPL-2.0-only

config QCOM_SCM
	tristate "Onyx Qualcomm secure monitor module"
	help
	  Build the pinned Onyx vendor SCM implementation as an external module.

config QTEE_SHM_BRIDGE
	bool "Onyx QTEE shared memory bridge"
	depends on QCOM_SCM
	help
	  The Onyx SCM module includes the vendor shared-memory bridge allocator.

config IPC_LOGGING
	tristate "Qualcomm IPC logging"

config IPC_LOGGING_CDEV
	bool "IPC log character device"
	depends on IPC_LOGGING

config IPC_LOG_MINIDUMP_BUFFERS
	int "IPC log buffers registered with minidump"
	depends on IPC_LOGGING
	default 16

config QCOM_CRM_V2
	tristate "Onyx clock resource manager v2"

config QCOM_RPMH_TIMEOUT
	int "RPMh and CRM request timeout in milliseconds"
	default 5000

config REGMAP_QTI_DEBUGFS
	tristate "Qualcomm register map debugfs"
	depends on DEBUG_FS

config REGULATOR_DEBUG_CONTROL
	tristate "Qualcomm regulator debug controls"
	depends on REGULATOR && DEBUG_FS

config REGULATOR_PROXY_CONSUMER
	tristate "Qualcomm regulator proxy consumers"
	depends on REGULATOR

config REGULATOR_PROXY_CONSUMER_LEGACY
	bool "Legacy boot proxy votes"
	depends on REGULATOR_PROXY_CONSUMER

config REGULATOR_RPMH
	tristate "Onyx RPMh regulators"
	depends on REGULATOR

config QCOM_GDSC_REGULATOR
	tristate "Qualcomm GDSC regulators"
	depends on COMMON_CLK_QCOM

config SM_DISPCC_TUNA
	tristate "Onyx dispcc_tuna clocks"
	depends on COMMON_CLK_QCOM

config SM_CAMBISTMCLKCC_TUNA
	tristate "Onyx cambistmclkcc_tuna clocks"
	depends on COMMON_CLK_QCOM

config SM_VIDEOCC_TUNA
	tristate "Onyx videocc_tuna clocks"
	depends on COMMON_CLK_QCOM

config SM_CAMCC_TUNA
	tristate "Onyx camcc_tuna clocks"
	depends on COMMON_CLK_QCOM

config SM_GCC_TUNA
	tristate "Onyx gcc_tuna clocks"
	depends on COMMON_CLK_QCOM

config SM_GPUCC_TUNA
	tristate "Onyx gpucc_tuna clocks"
	depends on COMMON_CLK_QCOM

config SM_TCSRCC_TUNA
	tristate "Onyx tcsrcc_tuna clocks"
	depends on COMMON_CLK_QCOM

config SM_DEBUGCC_TUNA
	tristate "Onyx debugcc_tuna clocks"
	depends on COMMON_CLK_QCOM

config SM_EVACC_TUNA
	tristate "Onyx evacc_tuna clocks"
	depends on COMMON_CLK_QCOM

config INTERCONNECT_QCOM_QOS
	tristate "Onyx interconnect qos"
	depends on INTERCONNECT_QCOM

config INTERCONNECT_QCOM_DEBUG
	tristate "Onyx interconnect debug"
	depends on INTERCONNECT_QCOM

config INTERCONNECT_QCOM_TUNA
	tristate "Onyx interconnect tuna"
	depends on INTERCONNECT_QCOM && OF
	select INTERCONNECT_QCOM_BCM_VOTER
	select INTERCONNECT_QCOM_RPMH
	select INTERCONNECT_QCOM_QOS

config PHY_QCOM_UFS
	tristate "Onyx phy_qcom_ufs"
	depends on GENERIC_PHY

config PHY_QCOM_UFS_V4_SUN
	tristate "Onyx phy_qcom_ufs_v4_sun"
	depends on PHY_QCOM_UFS

config QTI_PMIC_PON_LOG
	tristate "Onyx qti_pmic_pon_log"
	depends on NVMEM

config POWER_RESET_QCOM_REBOOT_REASON
	tristate "Onyx power_reset_qcom_reboot_reason"
	depends on NVMEM

config REGULATOR_STUB
	tristate "Onyx regulator_stub"
	depends on REGULATOR

config SCSI_UFS_CRYPTO_QTI
	tristate "Onyx UFS hardware wrapped keys"
	depends on SCSI_UFS_CRYPTO && SCSI_UFS_QCOM && QCOM_INLINE_CRYPTO_ENGINE

config GH_ARM64_DRV
	tristate "Onyx Gunyah ARM64 services"
	depends on GUNYAH

config GH_DBL
	tristate "Onyx Gunyah doorbells"
	depends on GUNYAH

config GH_MSGQ
	tristate "Onyx Gunyah message queues"
	depends on GUNYAH

config GH_RM_DRV
	tristate "Onyx Gunyah vendor resource manager"
	depends on GUNYAH

config GH_IRQ_LEND
	tristate "Onyx Gunyah IRQ lending"
	depends on GUNYAH
	depends on GH_RM_DRV

config GH_MEM_NOTIFIER
	tristate "Onyx Gunyah memory notification"
	depends on GUNYAH
	depends on GH_RM_DRV

config GH_CTRL
	tristate "Onyx Gunyah hypervisor control"
	depends on GUNYAH
	depends on SYSFS
	select SYS_HYPERVISOR

config QRTR_GUNYAH
	tristate "Onyx QRTR Gunyah transport"
	depends on GUNYAH
	depends on QRTR && GH_MSGQ && GH_RM_DRV

config QRTR_NODE_ID
	int "Onyx QRTR local node ID"
	depends on QRTR
	default 1

config QRTR_WAKEUP_MS
	int "Onyx QRTR wakeup timeout"
	depends on QRTR
	default 0

config QCOM_SECURE_BUFFER
	tristate "Onyx secure memory assignment"
	depends on QCOM_SCM

config GH_SECURE_VM_LOADER
	tristate "Onyx secure VM loader"
	depends on GUNYAH && GH_RM_DRV
	select QCOM_MDT_LOADER
	select QCOM_SECURE_BUFFER

config GH_PROXY_SCHED
	tristate "Onyx proxy scheduling for secondary VMs"
	depends on GH_SECURE_VM_LOADER

config QCOM_IOMMU_UTIL
	tristate "Onyx IOMMU support"
	depends on IOMMU_API

config IOMMU_IO_PGTABLE_FAST
	bool "Onyx preallocated IOMMU page tables"
	depends on IOMMU_DMA && ARM64_4K_PAGES

config QCOM_LAZY_MAPPING
	tristate "Onyx reference-counted DMA-BUF mappings"
	depends on IOMMU_API && DMA_SHARED_BUFFER

config QTI_IOMMU_SUPPORT
	tristate "Onyx IOMMU domain tracking"
	depends on IOMMU_API

config QCOM_CPU_PHYS_LOG_MAP
	tristate "Onyx physical CPU numbering"
	depends on SMP && OF

config QCOM_LLCC_PERFMON
	tristate "Onyx LLCC performance monitor"
	depends on QCOM_LLCC

config QCOM_LLCC_PMU
	tristate "Onyx LLCC PMU"
	depends on PERF_EVENTS && QCOM_CPU_PHYS_LOG_MAP

config GIC_INTERRUPT_ROUTING
	tristate "Onyx GIC interrupt routing"
	depends on ARM_GIC_V3 && SMP

config MSM_QMP
	tristate "Onyx QMP mailbox transport"
	depends on MAILBOX && QCOM_AOSS_QMP

config QCOM_MEM_BUF_DEV
	tristate "Onyx shared memory permissions"
	depends on DMA_SHARED_BUFFER

config QCOM_MEM_BUF_DEV_GH
	bool "Onyx Gunyah shared memory permissions"
	depends on QCOM_MEM_BUF_DEV && GH_RM_DRV

config QCOM_MEM_BUF_MSGQ
	tristate "Onyx shared memory message queue"
	depends on GH_MSGQ && QCOM_MEM_BUF_DEV_GH

config QCOM_MEM_BUF
	tristate "Onyx memory buffer sharing"
	depends on QCOM_MEM_BUF_DEV

config QCOM_MEM_BUF_GH
	bool "Onyx Gunyah memory buffer sharing"
	depends on QCOM_MEM_BUF && QCOM_MEM_BUF_DEV_GH

config QCOM_DMABUF_HEAPS
	tristate "Onyx DMA-BUF heaps"
	depends on DMABUF_HEAPS && QCOM_MEM_BUF_DEV

config QCOM_DMABUF_HEAPS_SYSTEM
	bool "Onyx system heap"
	depends on QCOM_DMABUF_HEAPS

config QCOM_DMABUF_HEAPS_PAGE_POOL_REFILL
	bool "Onyx system heap page pool refill"
	depends on QCOM_DMABUF_HEAPS_SYSTEM

config QCOM_DMABUF_HEAPS_SYSTEM_SECURE
	bool "Onyx secure system heap"
	depends on QCOM_DMABUF_HEAPS_SYSTEM && QCOM_SECURE_BUFFER

config QCOM_DMABUF_HEAPS_CMA
	bool "Onyx CMA heap"
	depends on QCOM_DMABUF_HEAPS && DMA_CMA

config QCOM_DMABUF_HEAPS_CARVEOUT
	bool "Onyx carveout heaps"
	depends on QCOM_DMABUF_HEAPS

config DMABUF_HEAPS_DEFERRED_FREE
	tristate "Onyx DMA-BUF deferred free helper"
	depends on DMA_SHARED_BUFFER

config QCOM_CPUCP
	tristate "Onyx CPU power-control mailbox"
	depends on MAILBOX

config QTI_SCMI_VENDOR_PROTOCOL
	tristate "Onyx SCMI vendor protocol"
	depends on ARM_SCMI_PROTOCOL

config QTI_QCOM_SCMI_CLIENT
	tristate "Onyx SCMI client"
	depends on ARM_SCMI_PROTOCOL

config QCOM_DCVS_FP
	tristate "Onyx DDR and LLCC fast frequency voting"
	depends on QCOM_RPMH

config QCOM_DCVS
	tristate "Onyx bus frequency voting"
	depends on INTERCONNECT && QCOM_DCVS_FP

config QCOM_PMU_LIB
	tristate "Onyx CPU performance counter service"
	depends on PERF_EVENTS && QCOM_LLCC_PMU && QCOM_CPU_PHYS_LOG_MAP && QTI_QCOM_SCMI_CLIENT

config ARM_QCOM_CPUFREQ_THERMAL
	tristate "Onyx CPU frequency thermal notification"
	depends on CPU_FREQ && MAILBOX

config QCOM_QFPROM_SYS
	tristate "Onyx QFPROM sysfs cells"
	depends on NVMEM_QCOM_QFPROM

config QCOM_DEBUG_SYMBOL
	tristate "Onyx crash diagnostic symbol lookup"
	depends on ANDROID_DEBUG_KINFO && KALLSYMS

config QCOM_MINIDUMP
	tristate "Onyx qcom minidump"
	depends on QCOM_SMEM && GH_RM_DRV && QCOM_DEBUG_SYMBOL

config QCOM_MINIDUMP_FTRACE
	bool "Onyx qcom minidump ftrace"
	depends on QCOM_MINIDUMP

config QCOM_MINIDUMP_PANIC_DUMP
	bool "Onyx qcom minidump panic dump"
	depends on QCOM_MINIDUMP

config QCOM_MINIDUMP_PANIC_CPU_CONTEXT
	bool "Onyx qcom minidump panic cpu context"
	depends on QCOM_MINIDUMP_PANIC_DUMP

config QCOM_MINIDUMP_PANIC_MEMORY_INFO
	bool "Onyx qcom minidump panic memory info"
	depends on QCOM_MINIDUMP_PANIC_DUMP

config QCOM_MINIDUMP_PANIC_CPUFREQ_INFO
	bool "Onyx qcom minidump panic cpufreq info"
	depends on QCOM_MINIDUMP_PANIC_DUMP

config QCOM_MINIDUMP_PANIC_KTASK_STACK
	bool "Onyx qcom minidump panic ktask stack"
	depends on QCOM_MINIDUMP_PANIC_DUMP && DETECT_HUNG_TASK

config QCOM_MINIDUMP_PSTORE
	bool "Onyx qcom minidump pstore"
	depends on QCOM_MINIDUMP

config QCOM_LOGBUF_VENDOR_HOOKS
	tristate "Onyx qcom logbuf vendor hooks"
	depends on QCOM_MINIDUMP

config QCOM_LOGBUF_BOOTLOG
	tristate "Onyx qcom logbuf bootlog"
	depends on QCOM_MINIDUMP

config MINIDUMP_MAX_ENTRIES
	int "Onyx minidump table capacity"
	depends on QCOM_MINIDUMP
	default 200

config QCOM_WDT_CORE
	tristate "Onyx Qualcomm watchdog core"
	depends on ARCH_QCOM

config GH_VIRT_WATCHDOG
	tristate "Onyx Gunyah watchdog"
	depends on QCOM_WDT_CORE

config QCOM_IRQ_STAT
	bool "Onyx Watchdog IRQ statistics"
	depends on QCOM_WDT_CORE

config QCOM_FORCE_WDOG_BITE_ON_PANIC
	bool "Onyx Watchdog bite on panic"
	depends on QCOM_WDT_CORE

config QCOM_WATCHDOG_BARK_TIME
	int "Onyx Watchdog bark interval"
	depends on QCOM_WDT_CORE

config QCOM_WATCHDOG_PET_TIME
	int "Onyx Watchdog pet interval"
	depends on QCOM_WDT_CORE

config QCOM_WATCHDOG_IPI_PING
	bool "Onyx Watchdog CPU pings"
	depends on QCOM_WDT_CORE

config QCOM_WATCHDOG_WAKEUP_ENABLE
	bool "Onyx Watchdog wakeup"
	depends on QCOM_WDT_CORE

config QCOM_CPU_VENDOR_HOOKS
	tristate "Onyx CPU vendor hooks"
	depends on ANDROID_VENDOR_HOOKS

config QTI_THERMAL_VENDOR_HOOK
	tristate "Onyx thermal vendor hooks"
	depends on ANDROID_VENDOR_HOOKS && THERMAL && !THERMAL_STATISTICS

config QTI_BCL_PMIC5
	tristate "Onyx PMIC battery-current limiting"
	depends on THERMAL && REGMAP && OF

config QTI_BCL_SOC_DRIVER
	tristate "Onyx battery state-of-charge monitoring"
	depends on THERMAL_OF && POWER_SUPPLY

config QCOM_SPMI_ADC5_GEN3
	tristate "Onyx PMIC Gen3/Gen4 ADC and threshold monitor"
	depends on SPMI && IIO
	select REGMAP_SPMI
	select QCOM_VADC_COMMON

config QCOM_MEMORY_DUMP_V2
	tristate "Onyx memory dump tables"
	depends on QCOM_MINIDUMP && QCOM_SCM

config QCOM_DCC_V2
	tristate "Onyx data capture controller"
	depends on QCOM_MEMORY_DUMP_V2

config POWER_RESET_QCOM_DOWNLOAD_MODE
	tristate "Onyx download mode"
	depends on QCOM_MINIDUMP && QCOM_SCM

config POWER_RESET_QCOM_DOWNLOAD_MODE_DEFAULT
	bool "Onyx download mode default"
	depends on POWER_RESET_QCOM_DOWNLOAD_MODE

config MIEV
	tristate "Onyx Xiaomi event channel"

config MI_BOOT_TIME
	tristate "Onyx Xiaomi boot profiler"
	depends on PROC_FS && TRACEPOINTS

config SCHED_WALT
	tristate "Onyx window-based load tracking scheduler"
	depends on SMP && CPU_FREQ && ANDROID_VENDOR_HOOKS

config QTI_CPU_PAUSE_COOLING_DEVICE
	tristate "Onyx CPU pause cooling"
	depends on THERMAL && SCHED_WALT

config QTI_CPU_HOTPLUG_COOLING_DEVICE
	tristate "Onyx CPU hotplug cooling"
	depends on THERMAL && HOTPLUG_CPU

config USB_REPEATER
	tristate "USB repeater framework"

config QTI_PMIC_EUSB2_REPEATER
	tristate "QTI eUSB2 repeater"
	depends on USB_REPEATER

config USB_MSM_EUSB2_PHY
	tristate "Onyx eUSB2 PHY"
	depends on USB_REPEATER

config MSM_GPI_DMA
	tristate "Onyx GPI DMA"
	depends on ARCH_QCOM
	select DMA_ENGINE
	select DMA_VIRTUAL_CHANNELS

config I2C_MSM_GENI
	tristate "Onyx GENI I2C"
	depends on I2C && QCOM_GENI_SE && MSM_GPI_DMA

config SPI_MSM_GENI
	tristate "Onyx GENI SPI"
	depends on SPI && QCOM_GENI_SE && MSM_GPI_DMA

config RPMSG_QCOM_GLINK
	tristate "Onyx Qualcomm GLINK"

config QCOM_SMP2P_SLEEPSTATE
	tristate "Onyx SMP2P sleep-state notifications"
	depends on QCOM_SMP2P

config RPROC_SSR_NOTIF_TIMEOUT
	int "Onyx subsystem restart notifier timeout"
	default 10000

config QCOM_RPROC_COMMON
	tristate "Onyx remoteproc common services"

config QCOM_PDR_HELPERS
	tristate "Onyx PDR helpers"

config PDR_INDICATION_NOTIF_TIMEOUT
	int "Onyx PDR notifier timeout in milliseconds"
	default 3000

config QCOM_PANIC_ON_NOTIF_TIMEOUT
	bool "Onyx panic on subsystem notification timeout"

config QCOM_PANIC_ON_PDR_NOTIF_TIMEOUT
	bool "Onyx panic on PDR notification timeout"

config QCOM_RPROC_BOTH_DUMPS
	bool "Onyx collect both subsystem minidump and full dump"

config XM_POWER_SUPPLY
	tristate "Xiaomi MCA power supply framework"

config MCA_QCOM_ADSP
	tristate "Xiaomi MCA ADSP communication"
	depends on XM_POWER_SUPPLY && QTI_PMIC_GLINK

config MCA_QCOM_SMEM
	tristate "Xiaomi MCA shared battery information"
	depends on XM_POWER_SUPPLY

config QTI_PMIC_GLINK
	tristate "Qualcomm PMIC GLINK"
	depends on RPMSG
	select QCOM_PDR_HELPERS
	select QCOM_RPROC_COMMON

config UCSI_QTI_GLINK
	tristate "Onyx UCSI PMIC GLINK"
	depends on TYPEC_UCSI && QTI_PMIC_GLINK

config SERIAL_MSM_GENI
	tristate "Onyx GENI high-speed UART"
	depends on ARCH_QCOM && QCOM_GENI_SE && MSM_GPI_DMA
	select SERIAL_CORE

config QCOM_WCD_USBSS_I2C
	tristate "Onyx WCD939x USB switch"
	depends on I2C && UCSI_QTI_GLINK
	select REGMAP

config QCOM_Q6V5_COMMON
	tristate "Onyx Qualcomm Q6v5 support"

config QCOM_PIL_INFO
	tristate "Onyx PIL relocation information"

config QCOM_RAMDUMP
	tristate "Onyx Qualcomm remote processor dumps"
	depends on DEV_COREDUMP

config RPROC_SYSMON_NOTIF_TIMEOUT
	int "Onyx sysmon notification timeout in milliseconds"
	default 20000

config RPROC_SYSMON_SHUTDOWN_NOTIF_TIMEOUT
	int "Onyx sysmon shutdown timeout in milliseconds"
	default 10000

config MCA_EXTERNAL_FG
	tristate "MCA external fuel gauge"
	depends on XM_POWER_SUPPLY && I2C

config MCA_EXTERNAL_CP
	tristate "MCA SC8581 charge pump"
	depends on XM_POWER_SUPPLY && I2C

config USB_MSM_SSPHY_QMP
	tristate "Onyx QMP USB/DisplayPort PHY"
	depends on USB_PHY

config QCOM_EUD
	tristate "Onyx embedded USB debugger"
	depends on SERIAL_CORE && EXTCON && QCOM_SCM

config USB_REDRIVER
	tristate "Onyx USB redriver framework"



config MSM_SYSSTATS
	tristate "Onyx system/task statistics"
	depends on NET && MULTIUSER

config MSM_SYSSTATS_STUB_NONEXPORTED_SYMBOLS
	bool "Keep the Onyx ROM zero values for unavailable memory statistics"
	depends on MSM_SYSSTATS

config MSM_PERFORMANCE
	tristate "Onyx performance control and GPU events"
	depends on CPU_FREQ && SCHED_WALT && QCOM_PMU_LIB

config QCOM_PANEL_EVENT_NOTIFIER
	tristate "Onyx display panel events"
	depends on DRM_PANEL
config INPUT_FINGERPRINT
	bool "Onyx fingerprint support"
	depends on INPUT
config FINGERPRINT_MI_FP
	tristate "Onyx Xiaomi fingerprint"
	depends on INPUT_FINGERPRINT && QCOM_PANEL_EVENT_NOTIFIER
config FP_HAVE_MULTI_SCREEN
	bool "Fingerprint multiple displays"
config SIDE_FINGERPRINT
	bool "Side fingerprint sensor"
config FOD_FINGERPRINT
	bool "Fingerprint on display"

config USB_DWC3_MSM
	tristate "Onyx DWC3 controller"
	depends on USB_DWC3 && USB_REPEATER && USB_REDRIVER


# SPDX-License-Identifier: GPL-2.0-only
config QCOM_KGSL
	tristate "Qualcomm Technologies, Inc. 3D Graphics driver"
	depends on ARCH_QCOM
	depends on NVMEM_QCOM_QFPROM || QCOM_QFPROM
	select QCOM_MDT_LOADER
	select INTERVAL_TREE
	select TRACE_GPU_MEM
	help
	  3D graphics driver for the Adreno family of GPUs from QTI.
	  Required to use hardware accelerated OpenGL, compute and Vulkan
	  on QTI targets. This includes power management, memory management,
	  and scheduling for the Adreno GPUs.

config QCOM_KGSL_FENCE_TRACE
	bool "Enable built-in tracing for adreno fence timeouts"
	help
	  A boolean flag used to create a KGSL-specific tracing instance
	  under <tracefs>/tracing/instances/kgsl-fence that can be used
	  for debugging timeouts for fences between KGSL-contexts and
	  sync-point blocks. If unsure, say 'N' here.

config QCOM_ADRENO_DEFAULT_GOVERNOR
	string "devfreq governor for the adreno core"
	default "msm-adreno-tz"

config QCOM_KGSL_CORESIGHT
	bool "Enable coresight support for the Adreno GPU"
	depends on CORESIGHT
	default y
	help
	  When enabled, the Adreno GPU is available as a source for Coresight
	  data. On a6xx targets there are two sources available for the GX and
	  CX domains respectively. Debug kernels should say 'Y' here.

config QCOM_KGSL_IOCOHERENCY_DEFAULT
	bool "Enable I/O coherency on cached GPU memory by default"
	default y if ARCH_LAHAINA
	help
	 Say 'Y' here to enable I/O cache coherency by default on targets that
	 support hardware I/O coherency. If enabled all cached GPU memory
	 will use I/O coherency regardless of the user flags. If not enabled
	 the user can still selectively enable I/O coherency with a flag.

config QCOM_KGSL_IDLE_TIMEOUT
	int
	default 80
	help
	  GPU idle timeout for Adreno GPU. This value decides after how
	  long the GPU will go into slumber. A higher value will mean that
	  the GPU is powered ON for a longer duration which will have
	  power costs.

config QCOM_KGSL_CONTEXT_DEBUG
	bool "Log kgsl context information for all processes"
	help
	  When enabled, total number of KGSL contexts, number of attached and
	  detached contexts are dumped into kernel log for all the processes.
	  This gives insight about the number of contexts held by each process.

config QCOM_KGSL_SORT_POOL
	bool "Sort pool page list based on physical address"
	default y
	help
	  When enabled, the pool page list is sorted based on physical
	  addresses. This can be turned on for targets where better DDR
	  efficiency is attained on accesses for adjacent memory.

config QCOM_KGSL_QDSS_STM
	bool "Enable support for QDSS STM for Adreno GPU"
	depends on CORESIGHT
	help
	  When enabled, the Adreno GPU QDSS STM support is enabled. GPU QDSS STM
	  memory will be mapped to GPU and QDSS clock needed to access this memory
	  is voted. Debug kernels should say 'Y' here.

config QCOM_KGSL_USE_SHMEM
	bool "Enable using shmem for memory allocations"
	depends on SHMEM
	help
	  Say 'Y' to enable using shmem for memory allocations. If enabled,
	  there will be no support for the memory pools and higher order pages.
	  But using shmem will help in making kgsl pages available for
	  reclaiming.

config QCOM_KGSL_PROCESS_RECLAIM
	bool "Make driver pages available for reclaim"
	select QCOM_KGSL_USE_SHMEM
	help
	  Say 'Y' to make driver pages available for reclaiming. If enabled,
	  shmem will be used for allocation. kgsl would know the process
	  foreground/background activity through the sysfs entry exposed per
	  process. Based on this kgsl can unpin given number of pages from
	  background processes and make them available to the shrinker.

config QCOM_KGSL_HIBERNATION
	bool "Enable Hibernation support in KGSL"
	depends on HIBERNATION
	help
	  Say 'Y' to enable hibernation support in kgsl. If enabled, kgsl
	  will register necessary power manager callbacks to support
	  hibernation.

config QCOM_KGSL_SYNX
	bool "Use synx APIs in KGSL for HW fences"
	help
	  Say 'Y' to enable synx API in kgsl. If enabled, kgsl  will use
	  synx API for HW fence feature. This allows hardware fence inter-op
	  between HW fence clients and SYNX clients. If not enabled, then
	  kgsl will use msm_hw_fence APIs for hardware fence feature.

config QTI_HW_FENCE
	bool "HW Fence"
	help
	  Enable the hw_fence module

config QTI_HW_FENCE_USE_SYNX
	bool "HW Fence uses synx"
	help
	  Enable the hw_fence module through synx api.
	  This will enable hw-fence module to register
	  hw-fence ops with synx module to support hw-
	  fencing through synx api and inter-op
	  functionality between synx and hw-fence.

config QTI_ENABLE_HW_FENCE_DEFAULT
	bool "HW Fence is enabled by default"
	help
	  Enable the hw_fence module by default.
	  This config allow hw-fence client registrations
	  by default without any fastboot commands.
	  HW-fencing can still be disabled and reenabled
	  at runtime through fastboot commands.

config SYNX_SUN
	bool "Onyx Sun SYNX platform"

config DEVFREQ_GOV_QCOM_ADRENO_TZ
	tristate "Onyx Adreno trusted-zone devfreq governor"

config DEVFREQ_GOV_QCOM_GPUBW_MON
	tristate "Onyx GPU bandwidth devfreq governor"

config QCOM_SPEC_SYNC
	bool "Enable spec fence"
	help
	  Enable sync_fence driver
config NXP_NFC_I2C
	tristate "Onyx NXP NFC I2C"
	depends on I2C

config USB_F_CCID
	tristate "Onyx CCID gadget"
	depends on USB_CONFIGFS
config USB_F_CDEV
	tristate "Onyx serial character gadget"
	depends on USB_CONFIGFS
config USB_F_FS_IPC_LOGGING
	tristate "Onyx FunctionFS IPC logging"
	depends on IPC_LOGGING && ARM64 && KPROBES
config USB_CONFIGFS_F_CCID
	tristate "Onyx CCID configfs function"
	depends on USB_CONFIGFS
	select USB_F_CCID
config USB_CONFIGFS_F_CDEV
	tristate "Onyx CDEV configfs function"
	depends on USB_CONFIGFS
	select USB_F_CDEV

config QTI_ALTMODE_GLINK
	tristate "Onyx Type-C alternate mode PMIC GLINK"
	depends on QTI_PMIC_GLINK
config QCOM_FSA4480_I2C
	tristate "Onyx FSA4480/DIO4485 Type-C switch"
	depends on I2C && UCSI_QTI_GLINK

config QCOM_VA_MINIDUMP
	tristate "Onyx virtual-address minidump"
	depends on QCOM_MINIDUMP


config QSEECOM_PROXY
	tristate "Onyx QSEECOM_PROXY"

config QCOM_SI_CORE
	tristate "Onyx QCOM_SI_CORE"

config QCOM_SI_CORE_WQ
	bool "Onyx QCOM_SI_CORE_WQ"

config QCOM_SI_CORE_MEM_OBJECT
	tristate "Onyx QCOM_SI_CORE_MEM_OBJECT"

config QCOM_SMCINVOKE
	tristate "Onyx QCOM_SMCINVOKE"

config QSEECOM_COMPAT
	bool "Onyx QSEECOM_COMPAT"

config HDCP_QSEECOM
	tristate "Onyx HDCP_QSEECOM"

config QTI_SMMU_PROXY
	tristate "Onyx QTI_SMMU_PROXY"

config DRM_DISPLAY_HELPER
	tristate "Onyx DRM display helpers"
	depends on DRM

config DRM_DISPLAY_DP_AUX_BUS
	tristate "Onyx DisplayPort AUX bus"
	depends on DRM && OF

config DRM_DISPLAY_DP_HELPER
	bool "Onyx DisplayPort helpers"

config DRM_DISPLAY_DSC_HELPER
	bool "Onyx display stream compression helpers"

config DRM_DISPLAY_HDCP_HELPER
	bool "Onyx HDCP helpers"

config MSM_MMRM
	tristate "Onyx multimedia resource manager"
	depends on COMMON_CLK

config MSM_EXT_DISPLAY
	tristate "Onyx external display audio interface"
	depends on EXTCON


config DRM_MSM_HELPER
	tristate "Onyx vendor DRM display driver"

config DRM_MSM_SDE
	bool "Onyx DRM_MSM_SDE"

config DRM_MSM_DSI
	bool "Onyx DRM_MSM_DSI"

config DRM_MSM_DP
	bool "Onyx DRM_MSM_DP"

config DRM_MSM_DP_MST
	bool "Onyx DRM_MSM_DP_MST"

config DSI_PARSER
	bool "Onyx DSI_PARSER"

config DRM_SDE_WB
	bool "Onyx DRM_SDE_WB"

config DRM_MSM_REGISTER_LOGGING
	bool "Onyx DRM_MSM_REGISTER_LOGGING"

config DRM_SDE_EVTLOG_DEBUG
	bool "Onyx DRM_SDE_EVTLOG_DEBUG"

config QCOM_MDSS_PLL
	bool "Onyx QCOM_MDSS_PLL"

config GKI_DISPLAY
	bool "Onyx GKI_DISPLAY"

config DRM_SDE_VM
	bool "Onyx DRM_SDE_VM"

config DRM_SDE_CESTA
	bool "Onyx DRM_SDE_CESTA"

config SMMU_PROXY
	bool "Onyx SMMU_PROXY"

config DRM_MSM_HDMI
	bool "Onyx DRM_MSM_HDMI"

config QCOM_WCD939X_I2C
	bool "Onyx QCOM_WCD939X_I2C"
```
