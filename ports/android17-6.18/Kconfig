## ports/android17-6.18/platform_defconfig
```kconfig
CONFIG_IPC_LOGGING=m
# CONFIG_IPC_LOGGING_CDEV is not set
CONFIG_IPC_LOG_MINIDUMP_BUFFERS=16
CONFIG_QCOM_COMMAND_DB=m
CONFIG_QCOM_RPMH=m
CONFIG_QCOM_CRM_V2=m
CONFIG_QCOM_RPMH_TIMEOUT=5000
CONFIG_HWSPINLOCK_QCOM=m
CONFIG_QCOM_SMEM=m
CONFIG_QCOM_SOCINFO=m
CONFIG_SPMI_MSM_PMIC_ARB=m
CONFIG_MFD_SPMI_PMIC=m
CONFIG_REGMAP_QTI_DEBUGFS=m
CONFIG_REGULATOR_DEBUG_CONTROL=m
CONFIG_REGULATOR_PROXY_CONSUMER=m
# CONFIG_REGULATOR_PROXY_CONSUMER_LEGACY is not set
CONFIG_REGULATOR_RPMH=m
CONFIG_COMMON_CLK_QCOM=m
CONFIG_QCOM_GDSC=y
CONFIG_QCOM_GDSC_REGULATOR=m
CONFIG_QCOM_CLK_RPMH=m
CONFIG_SM_DISPCC_TUNA=m
CONFIG_SM_CAMBISTMCLKCC_TUNA=m
CONFIG_SM_VIDEOCC_TUNA=m
CONFIG_SM_CAMCC_TUNA=m
CONFIG_SM_GCC_TUNA=m
CONFIG_SM_GPUCC_TUNA=m
CONFIG_SM_TCSRCC_TUNA=m
CONFIG_SM_DEBUGCC_TUNA=m
CONFIG_SM_EVACC_TUNA=m
CONFIG_INTERCONNECT_QCOM=y
CONFIG_INTERCONNECT_QCOM_BCM_VOTER=m
CONFIG_INTERCONNECT_QCOM_RPMH=m
CONFIG_INTERCONNECT_QCOM_QOS=m
CONFIG_INTERCONNECT_QCOM_DEBUG=m
CONFIG_INTERCONNECT_QCOM_TUNA=m
CONFIG_PHY_QCOM_UFS=m
CONFIG_PHY_QCOM_UFS_V4_SUN=m
CONFIG_NVMEM_SPMI_SDAM=m
CONFIG_RTC_DRV_PM8XXX=m
CONFIG_QTI_PMIC_PON_LOG=m
CONFIG_POWER_RESET_QCOM_REBOOT_REASON=m
CONFIG_POWER_RESET_QCOM_PON=m
CONFIG_REBOOT_MODE=m
CONFIG_REGULATOR_STUB=m
CONFIG_SCSI_UFS_QCOM=m
CONFIG_SCSI_UFS_CRYPTO_QTI=m
CONFIG_QCOM_INLINE_CRYPTO_ENGINE=m
CONFIG_GH_ARM64_DRV=m
CONFIG_GH_DBL=m
CONFIG_GH_MSGQ=m
CONFIG_GH_RM_DRV=m
CONFIG_GH_IRQ_LEND=m
CONFIG_GH_MEM_NOTIFIER=m
CONFIG_GH_CTRL=m
CONFIG_QRTR_GUNYAH=m
CONFIG_QRTR=m
CONFIG_QRTR_NODE_ID=1
CONFIG_QRTR_WAKEUP_MS=0
CONFIG_QCOM_SECURE_BUFFER=m
CONFIG_QCOM_MDT_LOADER=m
CONFIG_GH_SECURE_VM_LOADER=m
CONFIG_GH_PROXY_SCHED=m
CONFIG_QCOM_IOMMU_UTIL=m
CONFIG_IOMMU_IO_PGTABLE_FAST=y
CONFIG_QCOM_LAZY_MAPPING=m
CONFIG_QTI_IOMMU_SUPPORT=m
CONFIG_ARM_SMMU=m
CONFIG_ARM_SMMU_QCOM=m
CONFIG_ARM_SMMU_DISABLE_BYPASS_BY_DEFAULT=y
CONFIG_QCOM_CPU_PHYS_LOG_MAP=m
CONFIG_QCOM_LLCC=m
CONFIG_QCOM_LLCC_PERFMON=m
CONFIG_QCOM_LLCC_PMU=m
CONFIG_GIC_INTERRUPT_ROUTING=m
CONFIG_QCOM_AOSS_QMP=m
CONFIG_MSM_QMP=m
CONFIG_QCOM_IPCC=m
CONFIG_QCOM_MEM_BUF_DEV=m
CONFIG_QCOM_MEM_BUF_DEV_GH=y
CONFIG_QCOM_MEM_BUF_MSGQ=m
CONFIG_QCOM_MEM_BUF=m
CONFIG_QCOM_MEM_BUF_GH=y
CONFIG_QCOM_DMABUF_HEAPS=m
CONFIG_QCOM_DMABUF_HEAPS_SYSTEM=y
CONFIG_QCOM_DMABUF_HEAPS_PAGE_POOL_REFILL=y
CONFIG_QCOM_DMABUF_HEAPS_SYSTEM_SECURE=y
CONFIG_QCOM_DMABUF_HEAPS_CMA=y
CONFIG_QCOM_DMABUF_HEAPS_CARVEOUT=y
CONFIG_DMABUF_HEAPS_DEFERRED_FREE=m
CONFIG_QCOM_CPUCP=m
CONFIG_QTI_SCMI_VENDOR_PROTOCOL=m
CONFIG_QTI_QCOM_SCMI_CLIENT=m
CONFIG_QCOM_DCVS_FP=m
CONFIG_QCOM_DCVS=m
CONFIG_QCOM_PMU_LIB=m
CONFIG_ARM_QCOM_CPUFREQ_HW=m
CONFIG_ARM_QCOM_CPUFREQ_THERMAL=m
CONFIG_NVMEM_QCOM_QFPROM=m
CONFIG_QCOM_QFPROM_SYS=m
CONFIG_QCOM_DEBUG_SYMBOL=m
CONFIG_QCOM_MINIDUMP=m
CONFIG_QCOM_MINIDUMP_FTRACE=y
CONFIG_QCOM_MINIDUMP_PANIC_DUMP=y
CONFIG_QCOM_MINIDUMP_PANIC_CPU_CONTEXT=y
CONFIG_QCOM_MINIDUMP_PANIC_MEMORY_INFO=y
CONFIG_QCOM_MINIDUMP_PANIC_CPUFREQ_INFO=y
CONFIG_QCOM_MINIDUMP_PANIC_KTASK_STACK=y
CONFIG_QCOM_MINIDUMP_PSTORE=y
CONFIG_QCOM_LOGBUF_VENDOR_HOOKS=m
CONFIG_QCOM_LOGBUF_BOOTLOG=m
CONFIG_MINIDUMP_MAX_ENTRIES=200
CONFIG_QCOM_WDT_CORE=m
CONFIG_GH_VIRT_WATCHDOG=m
CONFIG_QCOM_IRQ_STAT=y
CONFIG_QCOM_FORCE_WDOG_BITE_ON_PANIC=y
CONFIG_QCOM_WATCHDOG_BARK_TIME=11000
CONFIG_QCOM_WATCHDOG_PET_TIME=9360
CONFIG_QCOM_WATCHDOG_IPI_PING=y
CONFIG_QCOM_WATCHDOG_WAKEUP_ENABLE=y
CONFIG_QCOM_CPU_VENDOR_HOOKS=m
CONFIG_QTI_THERMAL_VENDOR_HOOK=m
CONFIG_QCOM_TSENS=m
CONFIG_QTI_BCL_PMIC5=m
CONFIG_QTI_BCL_SOC_DRIVER=m
CONFIG_QCOM_SPMI_TEMP_ALARM=m
CONFIG_PINCTRL_QCOM_SPMI_PMIC=m
CONFIG_QCOM_VADC_COMMON=m
CONFIG_QCOM_SPMI_ADC5_GEN3=m
CONFIG_QCOM_MEMORY_DUMP_V2=m
CONFIG_QCOM_DCC_V2=m
CONFIG_POWER_RESET_QCOM_DOWNLOAD_MODE=m
CONFIG_POWER_RESET_QCOM_DOWNLOAD_MODE_DEFAULT=y
CONFIG_MIEV=m
CONFIG_MI_BOOT_TIME=m
CONFIG_SCHED_WALT=m
CONFIG_QTI_CPU_PAUSE_COOLING_DEVICE=m
CONFIG_QTI_CPU_HOTPLUG_COOLING_DEVICE=m

CONFIG_USB_REPEATER=m
CONFIG_QTI_PMIC_EUSB2_REPEATER=m
CONFIG_USB_MSM_EUSB2_PHY=m
CONFIG_NOP_USB_XCEIV=m

CONFIG_MSM_GPI_DMA=m
CONFIG_I2C_MSM_GENI=m
CONFIG_SPI_MSM_GENI=m

CONFIG_QCOM_QMI_HELPERS=m
CONFIG_QCOM_PDR_HELPERS=m
CONFIG_QCOM_SMP2P=m
CONFIG_QCOM_SMP2P_SLEEPSTATE=m
CONFIG_RPMSG_QCOM_GLINK=m
CONFIG_RPMSG_QCOM_GLINK_SMEM=m
CONFIG_RPMSG_QCOM_SMD=m
CONFIG_QCOM_RPROC_COMMON=m
CONFIG_RPROC_SSR_NOTIF_TIMEOUT=20000
CONFIG_PDR_INDICATION_NOTIF_TIMEOUT=9000
# CONFIG_QCOM_PD_MAPPER is not set
CONFIG_QCOM_PANIC_ON_NOTIF_TIMEOUT=y
CONFIG_QCOM_PANIC_ON_PDR_NOTIF_TIMEOUT=y
CONFIG_QCOM_RPROC_BOTH_DUMPS=y

CONFIG_XM_POWER_SUPPLY=m
CONFIG_MCA_QCOM_ADSP=m
CONFIG_MCA_QCOM_SMEM=m
CONFIG_QTI_PMIC_GLINK=m
CONFIG_UCSI_QTI_GLINK=m

CONFIG_SERIAL_MSM_GENI=m

CONFIG_QCOM_WCD_USBSS_I2C=m

CONFIG_QCOM_PIL_INFO=m
CONFIG_QCOM_Q6V5_COMMON=m
CONFIG_QCOM_Q6V5_PAS=m
CONFIG_QCOM_SYSMON=m
CONFIG_QCOM_RAMDUMP=m
CONFIG_RPROC_SYSMON_NOTIF_TIMEOUT=20000
CONFIG_RPROC_SYSMON_SHUTDOWN_NOTIF_TIMEOUT=10000

CONFIG_MCA_EXTERNAL_FG=m
CONFIG_MCA_EXTERNAL_CP=m

CONFIG_USB_MSM_SSPHY_QMP=m
CONFIG_QCOM_EUD=m
CONFIG_USB_REDRIVER=m



CONFIG_MSM_SYSSTATS=m
CONFIG_MSM_SYSSTATS_STUB_NONEXPORTED_SYMBOLS=y
CONFIG_MSM_PERFORMANCE=m

CONFIG_QCOM_PANEL_EVENT_NOTIFIER=m
CONFIG_INPUT_FINGERPRINT=y
CONFIG_FINGERPRINT_MI_FP=m
CONFIG_FOD_FINGERPRINT=y
CONFIG_INPUT_PM8941_PWRKEY=m

CONFIG_USB_DWC3_MSM=m
CONFIG_QCOM_KGSL=m
CONFIG_QCOM_KGSL_IDLE_TIMEOUT=80
CONFIG_QCOM_KGSL_SORT_POOL=y
CONFIG_QCOM_KGSL_CONTEXT_DEBUG=y
CONFIG_QCOM_KGSL_IOCOHERENCY_DEFAULT=y
CONFIG_QCOM_ADRENO_DEFAULT_GOVERNOR="msm-adreno-tz"
CONFIG_QCOM_KGSL_SYNX=y
CONFIG_QCOM_KGSL_USE_SHMEM=y
CONFIG_QCOM_KGSL_PROCESS_RECLAIM=y
# CONFIG_QCOM_KGSL_CORESIGHT is not set
# CONFIG_QCOM_KGSL_FENCE_TRACE is not set
CONFIG_QTI_HW_FENCE=y
CONFIG_QTI_HW_FENCE_USE_SYNX=y
# CONFIG_QTI_ENABLE_HW_FENCE_DEFAULT is not set
CONFIG_SYNX_SUN=y
CONFIG_DEVFREQ_GOV_QCOM_ADRENO_TZ=m
CONFIG_DEVFREQ_GOV_QCOM_GPUBW_MON=m
CONFIG_QCOM_SPEC_SYNC=y

CONFIG_NXP_NFC_I2C=m

CONFIG_USB_F_CCID=m
CONFIG_USB_F_CDEV=m
CONFIG_USB_F_FS_IPC_LOGGING=m
CONFIG_USB_CONFIGFS_F_CCID=m
CONFIG_USB_CONFIGFS_F_CDEV=m

CONFIG_QTI_ALTMODE_GLINK=m
CONFIG_QCOM_FSA4480_I2C=m

CONFIG_QCOM_VA_MINIDUMP=m

CONFIG_QSEECOM_PROXY=m
CONFIG_QCOM_SI_CORE=m
CONFIG_QCOM_SI_CORE_WQ=y
CONFIG_QCOM_SI_CORE_MEM_OBJECT=m
CONFIG_QCOM_SMCINVOKE=m
CONFIG_QSEECOM_COMPAT=y
CONFIG_HDCP_QSEECOM=m
CONFIG_QTI_SMMU_PROXY=m

CONFIG_DRM_DISPLAY_HELPER=m
CONFIG_DRM_DISPLAY_DP_AUX_BUS=m
CONFIG_DRM_DISPLAY_DP_HELPER=y
CONFIG_DRM_DISPLAY_DSC_HELPER=y
CONFIG_DRM_DISPLAY_HDCP_HELPER=y
CONFIG_MSM_MMRM=m
CONFIG_MSM_EXT_DISPLAY=m

# CONFIG_DRM_MSM is not set
CONFIG_DRM_MSM_HELPER=m
CONFIG_DRM_MSM_SDE=y
CONFIG_DRM_MSM_DSI=y
CONFIG_DRM_MSM_DP=y
CONFIG_DRM_MSM_DP_MST=y
CONFIG_DSI_PARSER=y
CONFIG_DRM_SDE_WB=y
CONFIG_DRM_MSM_REGISTER_LOGGING=y
CONFIG_DRM_SDE_EVTLOG_DEBUG=y
CONFIG_QCOM_MDSS_PLL=y
CONFIG_GKI_DISPLAY=y
CONFIG_DRM_SDE_VM=y
CONFIG_DRM_SDE_CESTA=y
CONFIG_SMMU_PROXY=y
CONFIG_DRM_MSM_HDMI=y
CONFIG_QCOM_WCD939X_I2C=y

# Audio feature macros come from the pinned native sunautoconf.h.

# Audio configuration comes from the pinned native sunautoconf.h.

CONFIG_XIAOMI_TOUCH=m
CONFIG_NT36532_TOUCH=m

# Pinned native sunautoconf.h supplies audio feature macros.

CONFIG_CNSS_OUT_OF_TREE=y
CONFIG_CNSS_GENL=m
CONFIG_WCNSS_MEM_PRE_ALLOC=m

CONFIG_PCI_MSM=m
CONFIG_QCOM_PCIE_PDC=m
CONFIG_MHI_BUS=m
CONFIG_MHI_BUS_MISC=y
# CONFIG_MHI_BUS_DEBUG is not set

# Pinned sunautoconf.h supplies native audio configuration.
```
