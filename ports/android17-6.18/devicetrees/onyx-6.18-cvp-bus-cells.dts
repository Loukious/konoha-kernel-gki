// SPDX-License-Identifier: GPL-2.0-only
/dts-v1/;
/plugin/;

/* Linux 6.18 no longer matches generic buses without #address-cells.
 * Native CVP IOVA tuples already use one address and one size cell.
 */
&{/soc/qcom,cvp@ab00000} {
	#address-cells = <1>;
	#size-cells = <1>;
};
