// SPDX-License-Identifier: GPL-2.0-only
/dts-v1/;
/plugin/;

/* Preserve the native IPA pool's inherited one address and one size cell. */
&{/soc/qcom,ipa@3e00000} {
	#address-cells = <1>;
	#size-cells = <1>;
};
