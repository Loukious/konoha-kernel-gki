// SPDX-License-Identifier: GPL-2.0-only
/dts-v1/;
/plugin/;

/* SLAVE_IPA_CFG belongs to cnoc_main, not cnoc_cfg. */
&{/soc/ssusb@a600000} {
	interconnects = <&aggre1_noc 50 &mc_virt 512>,
		       <&aggre1_noc 50 &cnoc_main 525>,
		       <&gem_noc 2 &config_noc 540>;
};
