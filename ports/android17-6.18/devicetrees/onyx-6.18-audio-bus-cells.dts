// SPDX-License-Identifier: GPL-2.0-only
/dts-v1/;
/plugin/;

/* The native audio IOVA tuples use one address and one size cell. */
&{/soc/spf_core_platform} {
	#address-cells = <1>;
	#size-cells = <1>;
};
